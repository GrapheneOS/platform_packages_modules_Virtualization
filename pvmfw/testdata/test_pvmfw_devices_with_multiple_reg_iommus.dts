/dts-v1/;

/include/ "test_crosvm_dt_base.dtsi"

/ {
    light {
        reg = <0x0 0xF000 0x0 0x1000>, <0x0 0xF100 0x0 0x1000>;
        interrupts = <0x0 0xF 0x4>;
        iommus = <&pviommu_0 0xF0>, <&pviommu_1 0xF1>;
    };

    pviommu_0: pviommu0 {
        compatible = "pkvm,pviommu";
        id = <0xFF0>;
        #iommu-cells = <1>;
    };

    pviommu_1: pviommu1 {
        compatible = "pkvm,pviommu";
        id = <0xFF1>;
        #iommu-cells = <1>;
    };
};
