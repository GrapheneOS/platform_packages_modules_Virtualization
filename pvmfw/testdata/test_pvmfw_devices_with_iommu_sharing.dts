/dts-v1/;

/include/ "test_crosvm_dt_base.dtsi"

/ {
    rng@90000000 {
        compatible = "android,rng";
        reg = <0x0 0x9 0x0 0xFF>;
        interrupts = <0x0 0xF 0x4>;
        google,eh,ignore-gctrl-reset;
        status = "okay";
        iommus = <&pviommu_0 0xFF0>;
    };

    led@70000000 {
        compatible = "android,led";
        reg = <0x0 0x1000 0x0 0x9>;
        interrupts = <0x0 0xF 0x5>;
        iommus = <&pviommu_0 0xFF1>;
    };

    pviommu_0: pviommu0 {
        compatible = "pkvm,pviommu";
        id = <0x4>;
        #iommu-cells = <1>;
    };
};
