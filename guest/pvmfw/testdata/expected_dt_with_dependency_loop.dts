/dts-v1/;

/include/ "platform_preprocessed.dts"

/ {
    node_c: node_c {
        phandle = <0x30>;
        loop_dep = <&node_c_loop>;
        reg = <0x0 0xFF200 0x0 0x1>;
        interrupts = <0x0 0xF 0x4>;
        iommus;
    };

    node_c_loop: node_c_loop {
        phandle = <0x36>;
        loop_dep = <&node_c>;
    };

    /delete-node/ pviommu0;
    /delete-node/ pviommu1;
    /delete-node/ pviommu2;
    /delete-node/ pviommu3;
    /delete-node/ pviommu4;
    /delete-node/ pviommu5;
    /delete-node/ pviommu6;
    /delete-node/ pviommu7;
    /delete-node/ pviommu8;
    /delete-node/ pviommu9;
};
